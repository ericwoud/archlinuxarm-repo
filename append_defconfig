## append_defconfig
```kconfig
CONFIG_AUTOBOOT=y
CONFIG_BOOTDELAY=1
CONFIG_OF_LIBFDT_OVERLAY=y
CONFIG_CMD_BTRFS=y
CONFIG_CMD_EXT4=y
CONFIG_CMD_SETEXPR=y
CONFIG_HUSH_PARSER=y
CONFIG_EFI_PARTITION=y
CONFIG_ENV_IS_IN_MMC=n
CONFIG_DISTRO_DEFAULTS=y
CONFIG_CMD_PWM=y
CONFIG_DM_PWM=y
CONFIG_PWM_MTK=y
CONFIG_CMD_MTD=y
CONFIG_MTD=y
CONFIG_DM_MTD=y
CONFIG_MTD_UBI=y
CONFIG_MTD_UBI_FASTMAP=y
CONFIG_CMD_UBI=y
CONFIG_CMD_UBI_RENAME=y
CONFIG_CMD_UBIFS=y
CONFIG_MTD_SPI_NAND=y
CONFIG_DM_SPI_FLASH=y
CONFIG_SPI_FLASH_SFDP_SUPPORT=y
CONFIG_SPI_FLASH_EON=y
CONFIG_SPI_FLASH_GIGADEVICE=y
CONFIG_SPI_FLASH_ISSI=y
CONFIG_SPI_FLASH_MACRONIX=y
CONFIG_SPI_FLASH_SPANSION=y
CONFIG_SPI_FLASH_STMICRO=y
CONFIG_SPI_FLASH_WINBOND=y
CONFIG_SPI_FLASH_XMC=y
CONFIG_SPI_FLASH_XTX=y
CONFIG_SPI_FLASH_MTD=y
CONFIG_SPI=y
CONFIG_DM_SPI=y
CONFIG_MTK_SPIM=y
CONFIG_MTK_SPI_NAND=y
CONFIG_MTK_SPI_NAND_MTD=y
CONFIG_PCI=y
CONFIG_PCIE_MEDIATEK_GEN3=y
CONFIG_CMD_PCI=y
CONFIG_NVME_PCI=y
CONFIG_NVME=y
CONFIG_GPIO_HOG=y
CONFIG_CMD_GPIO=y
CONFIG_CMD_SATA=y
CONFIG_AHCI=y
CONFIG_SCSI_AHCI=y
CONFIG_AHCI_PCI=y
CONFIG_DM_SCSI=y
CONFIG_AHCI=y
CONFIG_AHCI_PCI=y
CONFIG_SCSI_AHCI=y
CONFIG_SCSI=y
CONFIG_CMD_SCSI=y
CONFIG_PHY=y
CONFIG_PHY_MTK_TPHY=y
CONFIG_MTK_AHCI=y
```

## defconfig
```kconfig
CONFIG_NF_CONNTRACK_BRIDGE=m

CONFIG_NFT_FLOW_OFFLOAD=m
CONFIG_NF_FLOW_TABLE_PROCFS=y


CONFIG_DYNAMIC_DEBUG=y
CONFIG_DYNAMIC_DEBUG_CORE=y
CONFIG_DEBUG_BUGVERBOSE=y

CONFIG_VETH=m
```
